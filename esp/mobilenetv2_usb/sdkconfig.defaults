## esp/mobilenetv2_usb/sdkconfig.defaults
```kconfig
# Дефолты для ESP32-S3-DevKitC-1 N16R8 (16 МБ flash, 8 МБ Octal/OPI PSRAM).
# Создаётся командой `idf.py set-target esp32s3`; эти дефолты накладываются сверху.

CONFIG_IDF_TARGET="esp32s3"

# --- Flash: 16 МБ ---
CONFIG_ESPTOOLPY_FLASHSIZE_16MB=y
CONFIG_ESPTOOLPY_FLASHSIZE="16MB"

# --- PSRAM: 8 МБ Octal (OPI). Без режима OCT арена ESP-DL НЕ выделится. ---
CONFIG_SPIRAM=y
CONFIG_SPIRAM_MODE_OCT=y
CONFIG_SPIRAM_SPEED_80M=y
CONFIG_SPIRAM_USE_MALLOC=y

# --- CPU на полной частоте для инференса ---
CONFIG_ESP_DEFAULT_CPU_FREQ_MHZ_240=y

# --- Кастомная таблица разделов: вшитая INT8-модель требует большого app-раздела ---
CONFIG_PARTITION_TABLE_CUSTOM=y
CONFIG_PARTITION_TABLE_CUSTOM_FILENAME="partitions.csv"

# --- Консоль НЕ на USB-Serial-JTAG (ВАЖНО) ---
# Нативный USB (USB-Serial-JTAG) должен принадлежать ТОЛЬКО нашему драйверу данных.
# Если на той же периферии висит консоль — основная ИЛИ вторичная (а вторичная USB-Serial-JTAG
# консоль в ESP-IDF включена ПО УМОЛЧАНИЮ) — её вывод конфликтует с драйвером, и ответы
# протокола не доходят до host.py: в окне всё по нулям, а каждый кадр «зависает» до таймаута
# (отсюда и медленная работа). Поэтому:
#   * основную консоль уводим на UART (отдельный порт, ему даже не обязательно быть подключённым);
#   * вторичную USB-Serial-JTAG консоль полностью ОТКЛЮЧАЕМ.
# Прошивке это не мешает: flash по нативному USB идёт через ROM-загрузчик, отдельно от консоли
# приложения.
CONFIG_ESP_CONSOLE_UART_DEFAULT=y
CONFIG_ESP_CONSOLE_SECONDARY_NONE=y
CONFIG_LOG_DEFAULT_LEVEL_ERROR=y

# --- Достаточный стек app_main, чтобы декодировать JPEG и прогнать инференс прямо в нём ---
CONFIG_ESP_MAIN_TASK_STACK_SIZE=16384
```
